## package/starfive/Config.in
```kconfig
# starfive packages
source "package/starfive/wave511/Config.in"
source "package/starfive/wave521/Config.in"
source "package/starfive/wave420l/Config.in"
source "package/starfive/codaj12/Config.in"
source "package/starfive/sf-omx-il/Config.in"
source "package/starfive/sf-omx-il-test/Config.in"
source "package/starfive/v4l2_test/Config.in"
source "package/starfive/mailbox-test/Config.in"
source "package/starfive/e24-test/Config.in"
source "package/starfive/stfisp_setfile/Config.in.host"
```

## package/starfive/codaj12/Config.in
```kconfig
comment "codaj12 package"

config BR2_PACKAGE_CODAJ12
	bool "codaj12"
	depends on BR2_KERNEL_HEADERS_CUSTOM_GIT
	help
	  codaj12 package
```

## package/starfive/ffmpeg_test/Config.in
```kconfig
comment "ffmpeg test package"

config BR2_PACKAGE_FFMPEG_TEST
	bool "ffmpeg_test"
	depends on BR2_PACKAGE_LIBDRM
	depends on BR2_PACKAGE_FFMPEG
	help
	  Utility for ffmpeg test 
```

## package/starfive/pp_test/Config.in
```kconfig
config BR2_PACKAGE_PP_TEST
	bool "pp_test"

	help
	  pp test control format of src
```

## package/starfive/qt_test/Config.in
```kconfig
comment "qt test package"

config BR2_PACKAGE_QT_TEST
	bool "qt_test"
	help
	  Utility for testing qt project
```

## package/starfive/sf-omx-il-test/Config.in
```kconfig
comment "sf-omx-il-test package"

config BR2_PACKAGE_SF_OMX_IL_TEST
	bool "sf-omx-il-test"
	depends on BR2_PACKAGE_SF_OMX_IL && BR2_PACKAGE_FFMPEG
	help
	  sf-omx-il-test package
```

## package/starfive/sf-omx-il/Config.in
```kconfig
comment "wave511 package"

config BR2_PACKAGE_SF_OMX_IL
	bool "sf-omx-il"
	depends on BR2_PACKAGE_WAVE511 && BR2_PACKAGE_WAVE521
	help
	  sf-omx-il package
```

## package/starfive/starfive-firmware/Config.in
```kconfig
# starfive firmware packages

config BR2_PACKAGE_STARFIVE_FIRMWARE
	bool "starfive-firmware"
	help
	  This package provides additional various binary firmware files
	  based on BR2_PACKAGE_LINUX_FIRMWARE (closed binary blobs) for
	  such devices like bluetooth, wifi cards etc.

if BR2_PACKAGE_STARFIVE_FIRMWARE

menu "Starfive Bluetooth firmware"

config BR2_PACKAGE_STARFIVE_FIRMWARE_AP6256_BLUETOOTH
	bool "AP6256 Bluetooth"
	help
	  Firmware files for AP6256 Wireless bluetooth support.

endmenu # Bluetooth


menu "Starfive WiFi firmware"

config BR2_PACKAGE_STARFIVE_FIRMWARE_AP6256_SDIO_WIFI
	bool "AP6256 SDIO Wifi"
	help
	  Firmware files for the AP6256 Wifi module on SDIO.

endmenu # WiFi

endif # BR2_PACKAGE_STARFIVE_FIRMWARE
```

## package/starfive/usb_wifi/Config.in
```kconfig
config BR2_PACKAGE_USB_WIFI
	bool "usb wifi ecr6600u"
	help
	  firmware for usb wifi ecr6600u
```

## package/starfive/wave511/Config.in
```kconfig
comment "wave511 package"

config BR2_PACKAGE_WAVE511
	bool "wave511"
	depends on BR2_KERNEL_HEADERS_CUSTOM_GIT
	help
	  wave511 package
```

## package/starfive/wave521/Config.in
```kconfig
comment "wave521 package"

config BR2_PACKAGE_WAVE521
	bool "wave521"
	depends on BR2_KERNEL_HEADERS_CUSTOM_GIT
	help
	  wave521 package
	  
```

## package/v4lutils/Config.in
```kconfig
config BR2_PACKAGE_V4LUTILS
	bool "v4lutils"
	depends on BR2_TOOLCHAIN_HAS_THREADS # libv4l
	depends on BR2_USE_MMU # libv4l
	depends on !BR2_STATIC_LIBS # libv4l
	depends on BR2_INSTALL_LIBSTDCPP # libv4l
	depends on BR2_TOOLCHAIN_HEADERS_AT_LEAST_3_0 # libv4l
	select BR2_PACKAGE_LIBV4L
	help
		v4l-utils

comment "v4l-utils needs a toolchain w/ threads, dynamic library, C++ and headers >= 3.0"
	depends on BR2_USE_MMU
	depends on !BR2_TOOLCHAIN_HAS_THREADS || BR2_STATIC_LIBS \
		|| !BR2_INSTALL_LIBSTDCPP || !BR2_TOOLCHAIN_HEADERS_AT_LEAST_3_0
```
